## sdkconfig.defaults
```kconfig
CONFIG_IDF_TARGET="esp32s3"
CONFIG_ESPTOOLPY_FLASHSIZE_16MB=y
CONFIG_ESP_DEFAULT_CPU_FREQ_MHZ_240=y
CONFIG_FREERTOS_HZ=1000
CONFIG_SPIRAM=y
CONFIG_SPIRAM_MODE_QUAD=y
CONFIG_SPIRAM_SPEED_80M=y
CONFIG_SPIRAM_USE_MALLOC=y
CONFIG_ESP_CONSOLE_UART_DEFAULT=y
CONFIG_ESP_CONSOLE_SECONDARY_NONE=y
CONFIG_ESP_MAIN_TASK_STACK_SIZE=12288
CONFIG_ESP_MAIN_TASK_AFFINITY_CPU1=y
CONFIG_COMPILER_CXX_EXCEPTIONS=y
CONFIG_USB_DEVICE_UAC_AS_PART=y
CONFIG_UAC_SPEAKER_CHANNEL_NUM=2
CONFIG_UAC_MIC_CHANNEL_NUM=0
CONFIG_UAC_SAMPLE_RATE=48000
CONFIG_UAC_BIT_RESOLUTION_16=y
CONFIG_UAC_SPK_INTERVAL_MS=10
CONFIG_UAC_TINYUSB_TASK_PRIORITY=7
CONFIG_UAC_TINYUSB_TASK_CORE=0
CONFIG_UAC_SPK_TASK_PRIORITY=6
CONFIG_UAC_SPK_TASK_CORE=0
```
